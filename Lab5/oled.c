#include <avr/pgmspace.h>
#include <stdarg.h>
#include <stdio.h>

#include "oled.h"
//#include "font.h"



volatile char *ext_oled_cmd = (char *) 0x1000;
volatile char *ext_oled_data = (char *) 0x1200;
static uint8_t page     = 0;
static uint8_t column = 0;
int font_height = 8;
int font_width = 8;
int font_offset = 32;

void oled_cmd(char c){
	*ext_oled_cmd = c;
}
void oled_data(char d){
	*ext_oled_data = d;
}

void oled_init(void){
	oled_cmd(0xae);// display off
	oled_cmd(0xa1);//segment remap
	oled_cmd(0xda);//common pads hardware: alternative
	oled_cmd(0x12);
	oled_cmd(0xc8);//common output scan direction:com63~com0
	oled_cmd(0xa8);//multiplex ration mode:63
	oled_cmd(0x3f);
	oled_cmd(0xd5);//display divide ratio/osc. freq. mode
	oled_cmd(0x80);
	oled_cmd(0x81);//contrast control
	oled_cmd(0x50);
	oled_cmd(0xd9);//set pre-charge period
	oled_cmd(0x21);
	oled_cmd(0x20);//Set Memory Addressing Mode
	oled_cmd(0x02);
	oled_cmd(0xdb);//VCOM deselect level mode
	oled_cmd(0x30);
	oled_cmd(0xad);//master configuration
	oled_cmd(0x00);
	oled_cmd(0xa4);//out follows RAM content
	oled_cmd(0xa6);//set normal display
	oled_cmd(0xaf);// display on
	oled_reset();
}

#include <avr/pgmspace.h>


const unsigned char PROGMEM font4x6[95][8] = {
	{0b00000000,0b00000000,0b00000000,0b00000000,0b00000000,0b00000000,0b00000000,0b00000000}, //
	{0b00000000,0b00000110,0b01011111,0b01011111,0b00000110,0b00000000,0b00000000,0b00000000}, // !
	{0b00000000,0b00000111,0b00000111,0b00000000,0b00000111,0b00000111,0b00000000,0b00000000}, // "
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	{0b00000010,0b00000011,0b00000001,0b00000011,0b00000010,0b00000011,0b00000001,0b00000000}, // ~
};



void oled_reset(void){
	for(uint8_t i = 0; i < DISP_PAGES; i++){
		oled_clear_page(i);
	}
	oled_go_to_page(0);
	oled_go_to_column(0);
}

void oled_clear_page(uint8_t page){
	oled_go_to_page(page);
	oled_go_to_column(0);
	for(int i = 0; i < DISP_WIDTH; i++){
		oled_data(0);
	}
}






void oled_go_to_page(uint8_t p){
	page = p;
	oled_cmd(OLED_PMODE_PAGE_ADDRESS + page);
}

void oled_go_to_column(uint8_t c){
	column = c;
	uint8_t x = column * font_width;
	oled_cmd(OLED_PMODE_COLUMN_ADDRESS_LOWER + (x & 0x0f));
	oled_cmd(OLED_PMODE_COLUMN_ADDRESS_UPPER + ((x & 0xf0) >> 4));
}



void oled_char(char c){
	int j = c;
	j=j-font_offset;
	if(c == '\n'){
		for(uint8_t i = column*font_width; i < DISP_WIDTH; i++){
			oled_data(0);
		}
		page = (page + 1) % DISP_PAGES;
		oled_go_to_page(page);
		oled_go_to_column(0);
		} else {
		for (uint8_t i = 0; i < font_width; i++){
			oled_data(pgm_read_byte( &font4x6[j][i] ));
			//oled_write_data(pgm_read_byte( *font_addr + i ));
		}
		column++;
	}
}

static FILE oled_stdout = FDEV_SETUP_STREAM(oled_char, NULL, _FDEV_SETUP_WRITE);

void oled_printf(const  char *fmt, ...)
{
	
	char lcd_buff[5]={0}; //static allocation of buffer max 80 character
	va_list args;
	va_start(args, fmt);
	vfprintf(&oled_stdout,fmt,args); // put formated string to lcd_buffer
	va_end(args);
}